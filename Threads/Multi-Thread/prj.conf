## CMakeLists.txt
```
cmake_minimum_required(VERSION 3.22)
set(BOARD stm32_min_dev_blue)

find_package(Zephyr)
project(Mutlti-Thread)

target_sources(app PRIVATE src/main.c)
```

## prj.conf
```kconfig
CONFIG_TIMESLICING=y
CONFIG_TIMESLICE_SIZE=10
CONFIG_TIMESLICE_PRIORITY=0
```

## src/main.c
```c
#include<zephyr/kernel.h>
#include<zephyr/device.h>
#include<zephyr/drivers/gpio.h>

#define STACKSIZE 1024
#define THREAD0_PRIORITY 7
#define THREAD1_PRIORITY 7

void thread0(void)
{
	while (1) {
           printk("Hello, I am thread0\n");
		   //k_yield();
           //k_msleep(5);
		   k_busy_wait(1000000);

	}
}

void thread1(void)
{
	while (1) {
            printk("Hello, I am thread1\n");
			k_yield();
	        //k_msleep(5);
		   k_busy_wait(1000000);			
	}
}
K_THREAD_DEFINE(thread0_id, STACKSIZE, thread0, NULL, NULL, NULL,
		THREAD0_PRIORITY, 0, 0);
K_THREAD_DEFINE(thread1_id, STACKSIZE, thread1, NULL, NULL, NULL,
		THREAD1_PRIORITY, 0, 0);
```
